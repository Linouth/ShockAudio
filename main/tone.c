#include "audio.h"
#include "tone.h"

#include "freertos/FreeRTOS.h"
#include "freertos/task.h"
#include "esp_log.h"

static const char *TAG = "Tone";

static TaskHandle_t s_tone_task_handle = NULL;

static int s_generate = 0;

// Samplerate: 44100, bitsPerSample: 16, time: 0.05 sec
// TODO: Proper tone generation (this is just a test)
int sine_size = 2205;
int16_t sine[] = {
	0, 2579, 5142, 7673, 10156, 12577, 14919, 17169, 
	19313, 21336, 23227, 24974, 26566, 27994, 29247, 30319, 
	31203, 31894, 32386, 32677, 32766, 32651, 32334, 31816, 
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	-17195, -19337, -21359, -23249, -24994
};


static void tone_task(void *arg) {
    struct audio_state *state = (struct audio_state *) arg;

    int16_t data[8192] = {0};
    int data_len = 8192;

    while (state->running) {
        if (state->buffer_assigned[SOURCE_TONE] == -1) {
            ESP_LOGD(TAG, "No buffer assigned");
            vTaskDelay(1000/portTICK_PERIOD_MS);
            continue;
        }

        if (s_generate) {
            /* audio_write_ringbuf((void*)sine, sine_size, SOURCE_TONE); */
            for (int i = 0; i < 8; i++) {
                for (int j = 0; j < sine_size; j++) {
                    data[i*sine_size + j] = sine[j];
                }
            }
            audio_write_ringbuf((void*)data, data_len, SOURCE_TONE);
            
            s_generate = 0;
        } else {
            vTaskDelay(100/portTICK_PERIOD_MS);
        }
    }
}

void tone_task_start(struct audio_state *state) {
    xTaskCreate(tone_task, "Tone", 3*8192, state, configMAX_PRIORITIES-4, &s_tone_task_handle);
}

// TODO: Frequency control
void tone_gen() {
    s_generate = 1;
}
